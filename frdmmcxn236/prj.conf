## prj.conf
```kconfig
CONFIG_MCUX_PRJSEG_module.board.suite=y
CONFIG_MCUX_PRJSEG_module.board.use_board_clock=y
CONFIG_MCUX_COMPONENT_driver.clock=y
CONFIG_MCUX_COMPONENT_driver.inputmux_connections=y
CONFIG_MCUX_COMPONENT_driver.reset=y
CONFIG_MCUX_COMPONENT_device.CMSIS=y
CONFIG_MCUX_COMPONENT_device.system=y
CONFIG_MCUX_COMPONENT_device.startup=y
CONFIG_MCUX_COMPONENT_driver.common=y
CONFIG_MCUX_COMPONENT_driver.gpio=y
CONFIG_MCUX_COMPONENT_driver.lpflexcomm=y
CONFIG_MCUX_COMPONENT_driver.lpflexcomm_lpuart=y
CONFIG_MCUX_COMPONENT_driver.mcx_spc=y
CONFIG_MCUX_COMPONENT_driver.port=y
CONFIG_MCUX_COMPONENT_utility.assert_lite=y
CONFIG_MCUX_COMPONENT_utilities.misc_utilities=y
CONFIG_MCUX_COMPONENT_utility.str=y
CONFIG_MCUX_COMPONENT_utility.debug_console_lite=y
CONFIG_MCUX_COMPONENT_component.lpuart_adapter=y
CONFIG_MCUX_PRJSEG_module.board.clock=n
CONFIG_MCUX_PRJSEG_module.board.clock_customize_folder=y
CONFIG_MCUX_PRJSEG_module.board.boardfile=n
CONFIG_MCUX_PRJSEG_module.board.pinmux_project_folder=n
CONFIG_MCUX_PRJSEG_module.board.pinmux_customize_folder=y
CONFIG_MCUX_PRJSEG_project.hw_app_project_folder=n
CONFIG_MCUX_PRJSEG_project.hw_app_customize_folder=y
CONFIG_MCUX_PRJSEG_module.board.console_lite=n
```

## src/main.c
```c
#include "fsl_device_registers.h"
#include "board.h"
#include "logger.h"

//prod 
void vWorkerTask(void *pvParameters) {
    uint32_t id = (uint32_t)pvParameters;
    uint32_t counter = 0;

    for (;;) {
        log_msg(LOG_LEVEL_INFO, "Worker %d running iteration %u", id, counter++);
        vTaskDelay(pdMS_TO_TICKS(100));
    }
}

int main(void) {
    BOARD_InitBootPins();
    BOARD_InitBootClocks();

    // init log sys
    if (!logger_init()) {
        while (1); 
    }

    // limited to 12 tasks
    for (uint32_t i = 0; i < 12; i++) {
        char task_name[16];
        snprintf(task_name, sizeof(task_name), "Worker_%lu", i);
        xTaskCreate(vWorkerTask, task_name, configMINIMAL_STACK_SIZE + 128, (void *)i, tskIDLE_PRIORITY + 2, NULL);
    }

    vTaskStartScheduler();

    while (1);
}
```

## src/logger.h
```c
#ifndef LOGGER_H
#define LOGGER_H

#include <stdint.h>
#include <stdbool.h>
#include "FreeRTOS.h"   //rtos librares
#include "queue.h"
#include "task.h"

#define LOG_MAX_MESSAGE_LEN   128         //limit for msg len
#define LOG_QUEUE_DEPTH       32          //depth
#define LOGGER_TASK_STACK     512         //stacklimit
#define LOGGER_TASK_PRIO      (configMAX_PRIORITIES - 4)       //priority upto 5 tasks

typedef enum {
    LOG_LEVEL_DEBUG = 0,
    LOG_LEVEL_INFO,
    LOG_LEVEL_WARN,
    LOG_LEVEL_ERROR
} log_level_t;

typedef struct {
    uint32_t timestamp_ms;
    uint8_t task_id;
    log_level_t level;
    char message[LOG_MAX_MESSAGE_LEN];
} log_entry_t;

/* Public API */
bool logger_init(void);
void log_msg(log_level_t level, const char *fmt, ...);
void log_msg_from_isr(log_level_t level, const char *fmt, ...);

#endif
```
